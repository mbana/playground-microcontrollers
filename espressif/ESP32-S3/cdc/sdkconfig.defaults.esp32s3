## espressif/ESP32-S3/usb_cdc_basic/sdkconfig.defaults.esp32s3
```kconfig
# CONFIG_LOG_VERSION_2=y
# CONFIG_LOG_DEFAULT_LEVEL_VERBOSE=y
# CONFIG_LOG_MASTER_LEVEL=y
# CONFIG_LOG_TAG_LEVEL_IMPL_CACHE_SIZE=255
# CONFIG_LOG_COLORS=y
# CONFIG_LOG_TIMESTAMP_SOURCE_SYSTEM=y
# CONFIG_USB_HOST_CONTROL_TRANSFER_MAX_SIZE=4096
# CONFIG_USB_HOST_HUBS_SUPPORTED=y
# CONFIG_IDF_EXPERIMENTAL_FEATURES=y

CONFIG_IDF_TARGET="esp32s3"
CONFIG_ESP32_S3_USB_OTG=y
```
